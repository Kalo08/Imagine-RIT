## firmware_esp32p4/components/foveated_vision/Kconfig
```kconfig
menu "Camera (MIPI-CSI via esp_video)"
    config CAMERA_SCCB_I2C_PORT
        int "SCCB (sensor control) I2C port"
        default 1
    config CAMERA_SCCB_SCL_GPIO
        int "SCCB SCL GPIO"
        default 8
        help
          PLACEHOLDER: set to the camera connector's SCCB pins on your board.
    config CAMERA_SCCB_SDA_GPIO
        int "SCCB SDA GPIO"
        default 7
        help
          PLACEHOLDER: set to the camera connector's SCCB pins on your board.
endmenu
```

## firmware_esp32p4/components/imu_bno085/Kconfig
```kconfig
menu "BNO085 IMU (I2C)"
    config IMU_BNO085_I2C_PORT
        int "I2C port"
        default 0
    config IMU_BNO085_I2C_ADDR
        hex "7-bit I2C address (0x4A, or 0x4B with DI pin high)"
        default 0x4A
    config IMU_BNO085_SDA_GPIO
        int "SDA GPIO"
        default 7
        help
          PLACEHOLDER pin: set to your wiring.
    config IMU_BNO085_SCL_GPIO
        int "SCL GPIO"
        default 8
        help
          PLACEHOLDER pin: set to your wiring.
    config IMU_BNO085_INT_GPIO
        int "INT GPIO (active low, data ready)"
        default 5
    config IMU_BNO085_RST_GPIO
        int "RST GPIO"
        default 6
endmenu
```

## firmware_esp32p4/components/servo_bus/Kconfig
```kconfig
menu "Servo bus (half-duplex TTL)"
    config SERVO_BUS_UART_NUM
        int "UART port"
        default 1
    config SERVO_BUS_TX_GPIO
        int "UART TX GPIO (to buffer input)"
        default 22
        help
          PLACEHOLDER pin: set to the header pin you wire on the ESP32-P4-NANO.
    config SERVO_BUS_RX_GPIO
        int "UART RX GPIO (from buffer output)"
        default 21
        help
          PLACEHOLDER pin: set to your wiring.
    config SERVO_BUS_DIR_GPIO
        int "Direction GPIO (UART RTS -> tri-state buffer enable)"
        default 20
        help
          PLACEHOLDER pin: set to your wiring. Driven high while transmitting.
endmenu
```
